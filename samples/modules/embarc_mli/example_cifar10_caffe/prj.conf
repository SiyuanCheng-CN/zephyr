## CMakeLists.txt
```
# Copyright (c) 2021 Synopsys
# SPDX-License-Identifier: Apache-2.0

cmake_minimum_required(VERSION 3.13.1)

find_package(Zephyr REQUIRED HINTS $ENV{ZEPHYR_BASE})
project(hello_world)

zephyr_compile_definitions(
  V2DSP_XY
  _C_ARRAY_
)

zephyr_compile_options("-Wno-ignored-qualifiers")

zephyr_library_include_directories(
  ../auxiliary/
  src/
)

target_sources(app PRIVATE
    src/ml_api_cifar10_caffe_main.c
    src/cifar10_coefficients_hwcn_small.c
    src/cifar10_constants.h
    src/cifar10_model_hwcn.c
    src/cifar10_model.h
    src/cifar10_ref_inout.h
    ../auxiliary/examples_aux.c
    ../auxiliary/examples_aux.h
    ../auxiliary/idx_file.c
    ../auxiliary/idx_file.h
    ../auxiliary/tensor_transform.c
    ../auxiliary/tensor_transform.h
    ../auxiliary/tests_aux.c
    ../auxiliary/tests_aux.h
    src/small_test_base/labels.c
    src/small_test_base/tests.c
)
```

## prj.conf
```kconfig
# Copyright (c) 2021 Synopsys
# SPDX-License-Identifier: Apache-2.0
CONFIG_EMBARC_MLI=y
CONFIG_ARCMWDT_LIBC=y
CONFIG_CPLUSPLUS=y
```

## src/cifar10_constants.h
```c
/*
* Copyright 2019-2021, Synopsys, Inc.
* All rights reserved.
*
* This source code is licensed under the BSD-3-Clause license found in
* the LICENSE file in the root directory of this source tree.
*
*/

#ifndef _CIFAR10_CONSTANTS_H_
#define _CIFAR10_CONSTANTS_H_

#include "mli_config.h"

#include "cifar10_model.h"

/* -------------------------------------------------------------------------- */
/*                           labels and tests array                           */
/* -------------------------------------------------------------------------- */

extern const unsigned int tests[];
extern const unsigned int labels[];

/* -------------------------- labels and tests code ------------------------- */
enum tIdxArrayVal { LABELS = 0x0, TESTS };

struct tIdxArrayFlag {
	long position;
	enum tIdxArrayVal flag;
};

// Defining weight data type
//===================================
#if (MODEL_BIT_DEPTH == MODEL_SA_8)
#define W_EL_TYPE (MLI_EL_SA_8)
#define B_EL_TYPE (MLI_EL_SA_32)
typedef int8_t w_type;
typedef int32_t b_type;
#define W_FIELD pi8
#define B_FIELD pi32
#elif (MODEL_BIT_DEPTH == MODEL_FX_8W16D)
#define W_EL_TYPE (MLI_EL_FX_8)
#define B_EL_TYPE (MLI_EL_FX_8)
typedef int8_t w_type;
typedef int8_t b_type;
#define W_FIELD pi8
#define B_FIELD pi8
#else // (MODEL_BIT_DEPTH == MODEL_FX_16)
#define W_EL_TYPE (MLI_EL_FX_16)
#define B_EL_TYPE (MLI_EL_FX_16)
typedef int16_t w_type;
typedef int16_t b_type;
#define W_FIELD pi16
#define B_FIELD pi16
#endif


// Defining data sections attributes
//===================================
#if (PLATFORM == V2DSP_XY)
#if defined (__GNUC__) && !defined (__CCAC__)
// ARC GNU tools
// Model Weights attribute
#define _Wdata_attr __attribute__((section(".mli_model")))
#define _W  _Wdata_attr

// Model Weights (part 2) attribute 
#define _W2data_attr __attribute__((section(".mli_model_p2")))
#define _W2  _W2data_attr

// Bank X (XCCM) attribute
#define __Xdata_attr __attribute__((section(".Xdata")))
#define _X  __Xdata_attr

// Bank Y (YCCM) attribute
#define __Ydata_attr __attribute__((section(".Ydata")))
#define _Y  __Ydata_attr

// Bank Z (DCCM) attribute
#define __Zdata_attr __attribute__((section(".Zdata")))
#define _Z  __Zdata_attr

#else	
// Metaware tools
// Model Weights attribute
#define _Wdata_attr __attribute__((section(".mli_model")))
#define _W __xy _Wdata_attr

// Model Weights (part 2) attribute 
#define _W2data_attr __attribute__((section(".mli_model_p2")))
#define _W2 __xy _W2data_attr

// Bank X (XCCM) attribute
#define __Xdata_attr __attribute__((section(".Xdata")))
#define _X __xy __Xdata_attr

// Bank Y (YCCM) attribute
#define __Ydata_attr __attribute__((section(".Ydata")))
#define _Y __xy __Ydata_attr

// Bank Z (DCCM) attribute
#define __Zdata_attr __attribute__((section(".Zdata")))
#define _Z __xy __Zdata_attr
#endif // if defined (__GNUC__) && !defined (__CCAC__)


#elif (PLATFORM == V2DSP_VECTOR)

#define _Wdata_attr __attribute__((section(".vecmem_data")))
#define _W __vccm _Wdata_attr

// Model Weights (part 2) attribute
#define _W2data_attr __attribute__((section(".vecmem_data")))
#define _W2 __vccm _W2data_attr

// Bank X (XCCM) attribute
#define __Xdata_attr __attribute__((section(".vecmem_data")))
#define _X __vccm __Xdata_attr

// Bank Y (YCCM) attribute
#define __Ydata_attr __attribute__((section(".vecmem_data")))
#define _Y __vccm __Ydata_attr

// Bank Z (DCCM) attribute
#define __Zdata_attr __attribute__((section(".vecmem_data")))
#define _Z __vccm __Zdata_attr

#else // PLATFORM != V2DSP_XY && PLATFORM != V2DSP_VECTOR
#define _X __attribute__((section(".mli_ir_buf")))
#define _Y __attribute__((section(".mli_ir_buf")))
#define _Z __attribute__((section(".mli_ir_buf")))
#define _W __attribute__((section(".mli_model")))
#define _W2 __attribute__((section(".mli_model")))
#endif

//======================================================
//
// Common data transform (Qmn) defines
//
//======================================================

#define QMN(type, fraq, val)   (type)(val * (1u << (fraq)) + ((val >= 0)? 0.5f: -0.5f))
#define FRQ_BITS(int_part, el_type) ((sizeof(el_type)*8)-int_part-1)

//======================================================
//
// Common data transform (Qmn) defines
//
//======================================================

extern const w_type  _W  L1_conv_wt_buf[];
#if (MODEL_BIT_DEPTH == MODEL_SA_8)
extern const int8_t  conv1_w_fraq_arr[];
extern const int16_t conv1_w_scale_arr[];
extern const int16_t conv1_w_zp_arr[];
#endif

extern const b_type  _W  L1_conv_bias_buf[];
#if (MODEL_BIT_DEPTH == MODEL_SA_8)
extern const int8_t  conv1_b_fraq_arr[];
extern const int16_t conv1_b_scale_arr[];
extern const int16_t conv1_b_zp_arr[];
#endif


extern const w_type  _W  L2_conv_wt_buf[];
#if (MODEL_BIT_DEPTH == MODEL_SA_8)
extern const int8_t  conv2_w_fraq_arr[];
extern const int16_t conv2_w_scale_arr[];
extern const int16_t conv2_w_zp_arr[];
#endif

extern const b_type  _W  L2_conv_bias_buf[];
#if (MODEL_BIT_DEPTH == MODEL_SA_8)
extern const int8_t  conv2_b_fraq_arr[];
extern const int16_t conv2_b_scale_arr[];
extern const int16_t conv2_b_zp_arr[];
#endif


extern const w_type  _W2  L3_conv_wt_buf[];
#if (MODEL_BIT_DEPTH == MODEL_SA_8)
extern const int8_t  conv3_w_fraq_arr[];
extern const int16_t conv3_w_scale_arr[];
extern const int16_t conv3_w_zp_arr[];
#endif

extern const b_type  _W2  L3_conv_bias_buf[];
#if (MODEL_BIT_DEPTH == MODEL_SA_8)
extern const int8_t  conv3_b_fraq_arr[];
extern const int16_t conv3_b_scale_arr[];
extern const int16_t conv3_b_zp_arr[];
#endif


extern const w_type  _W2  L4_fc_wt_buf[];
#if (MODEL_BIT_DEPTH == MODEL_SA_8)
extern const int8_t  conv4_w_fraq_arr[];
extern const int16_t conv4_w_scale_arr[];
extern const int16_t conv4_w_zp_arr[];
#endif

extern const b_type  _W2  L4_fc_bias_buf[];
#if (MODEL_BIT_DEPTH == MODEL_SA_8)
extern const int8_t  conv4_b_fraq_arr[];
extern const int16_t conv4_b_scale_arr[];
extern const int16_t conv4_b_zp_arr[];
#endif

//======================================================
//
// Tensor's Integer bits per layer definitions
//
//======================================================
#if (MODEL_BIT_DEPTH == MODEL_FX_16) || (MODEL_BIT_DEPTH == MODEL_FX_8W16D)

#define CONV1_W_INT   (-1)
#define CONV1_B_INT   (0)
#define CONV1_OUT_INT (3)

#define CONV2_W_INT   (-1)
#define CONV2_B_INT   (-1)
#define CONV2_OUT_INT (5)

#define CONV3_W_INT   (-1)
#define CONV3_B_INT   (-2)
#define CONV3_OUT_INT (5)

#define FC4_W_INT   (-1)
#define FC4_B_INT   (-2)
#define FC4_OUT_INT (5)

#endif

//======================================================
//
// Shape and Fractional bits per layer definitions
//
//======================================================

// CONV1
//================================================
#define CONV1_W_SHAPE {5, 5, 3, 32}
#define CONV1_W_MEM_STRIDE {5 * 3 * 32, 3 * 32, 32, 1}
#define CONV1_W_ELEMENTS (5*5*3*32)
#define CONV1_W_RANK (4)

#if (MODEL_BIT_DEPTH == MODEL_SA_8)

#define CONV1_W_FRAQ    conv1_w_fraq_arr
#define CONV1_W_SCALE   conv1_w_scale_arr
#define CONV1_W_ZP      conv1_w_zp_arr
#define CONV1_W_DIM     3
#define CONV1_W_SA_ELEMENTS (32)

#else

#define CONV1_W_FRAQ   (FRQ_BITS(CONV1_W_INT, w_type))
#define L1_WQ(val)   QMN(w_type, CONV1_W_FRAQ, val)

#endif

#define CONV1_B_ELEMENTS (32)
#define CONV1_B_SHAPE {32}
#define CONV1_B_MEM_STRIDE {1}
#define CONV1_B_RANK (1)

#if (MODEL_BIT_DEPTH == MODEL_SA_8)

#define CONV1_B_FRAQ    conv1_b_fraq_arr
#define CONV1_B_SCALE   conv1_b_scale_arr
#define CONV1_B_ZP      conv1_b_zp_arr
#define CONV1_B_DIM     0
#define CONV1_B_SA_ELEMENTS (32)

#else

#define CONV1_B_FRAQ   (FRQ_BITS(CONV1_B_INT, w_type))
#define L1_BQ(val)   QMN(w_type, CONV1_B_FRAQ, val)
#define CONV1_OUT_FRAQ (FRQ_BITS(CONV1_OUT_INT, d_type))

#endif

#define CONV1_OUT_H (32)
#define CONV1_OUT_W (32)
#define CONV1_OUT_C (32)

// CONV2
//================================================
#define CONV2_W_SHAPE {5, 5, 32, 16}
#define CONV2_W_MEM_STRIDE {5 * 32 * 16, 32 * 16, 16, 1}
#define CONV2_W_ELEMENTS (5*5*32*16)
#define CONV2_W_RANK (4)

#if (MODEL_BIT_DEPTH == MODEL_SA_8)

#define CONV2_W_FRAQ    conv2_w_fraq_arr
#define CONV2_W_SCALE   conv2_w_scale_arr
#define CONV2_W_ZP      conv2_w_zp_arr
#define CONV2_W_DIM     3
#define CONV2_W_SA_ELEMENTS (16)

#else
#define CONV2_W_FRAQ   (FRQ_BITS(CONV2_W_INT, w_type))
#define L2_WQ(val)   QMN(w_type, CONV2_W_FRAQ, val)
#endif

#define CONV2_B_SHAPE {16}
#define CONV2_B_MEM_STRIDE {1}
#define CONV2_B_ELEMENTS (16)
#define CONV2_B_RANK (1)

#if (MODEL_BIT_DEPTH == MODEL_SA_8)

#define CONV2_B_FRAQ    conv2_b_fraq_arr
#define CONV2_B_SCALE   conv2_b_scale_arr
#define CONV2_B_ZP      conv2_b_zp_arr
#define CONV2_B_DIM     0
#define CONV2_B_SA_ELEMENTS (16)

#else

#define CONV2_B_FRAQ   (FRQ_BITS(CONV2_B_INT, w_type))
#define L2_BQ(val)   QMN(w_type, CONV2_B_FRAQ, val)
#define CONV2_OUT_FRAQ (FRQ_BITS(CONV2_OUT_INT, d_type))

#endif

#define CONV2_OUT_H (16)
#define CONV2_OUT_W (16)
#define CONV2_OUT_C (16)

// CONV3
//================================================
#define CONV3_W_SHAPE {5, 5, 16, 32}
#define CONV3_W_MEM_STRIDE {5 * 16 * 32, 16 * 32, 32, 1}
#define CONV3_W_ELEMENTS (5*5*16*32)
#define CONV3_W_RANK (4)

#if (MODEL_BIT_DEPTH == MODEL_SA_8)

#define CONV3_W_FRAQ    conv3_w_fraq_arr
#define CONV3_W_SCALE   conv3_w_scale_arr
#define CONV3_W_ZP      conv3_w_zp_arr
#define CONV3_W_DIM     3
#define CONV3_W_SA_ELEMENTS (32)

#else

#define CONV3_W_FRAQ   (FRQ_BITS(CONV3_W_INT, w_type))
#define L3_WQ(val)   QMN(w_type, CONV3_W_FRAQ, val)

#endif

#define CONV3_B_SHAPE {32}
#define CONV3_B_MEM_STRIDE {1}
#define CONV3_B_ELEMENTS (32)
#define CONV3_B_RANK (1)

#if (MODEL_BIT_DEPTH == MODEL_SA_8)

#define CONV3_B_FRAQ    conv3_b_fraq_arr
#define CONV3_B_SCALE   conv3_b_scale_arr
#define CONV3_B_ZP      conv3_b_zp_arr
#define CONV3_B_DIM     0
#define CONV3_B_SA_ELEMENTS (32)

#else

#define CONV3_B_FRAQ   (FRQ_BITS(CONV3_B_INT, w_type))
#define L3_BQ(val)   QMN(w_type, CONV3_B_FRAQ, val)
#define CONV3_OUT_FRAQ (FRQ_BITS(CONV3_OUT_INT, d_type))

#endif

#define CONV3_OUT_H (8)
#define CONV3_OUT_W (8)
#define CONV3_OUT_C (32)

// FC4
//================================================
#define FC4_W_SHAPE {(32*16), 10}
#define FC4_W_MEM_STRIDE {10, 1}
#define FC4_W_ELEMENTS (32*16*10)
#define FC4_W_RANK (2)

#if (MODEL_BIT_DEPTH == MODEL_SA_8)

#define CONV4_W_FRAQ    conv4_w_fraq_arr
#define CONV4_W_SCALE   conv4_w_scale_arr
#define CONV4_W_ZP      conv4_w_zp_arr
#define CONV4_W_DIM     1
#define CONV4_W_SA_ELEMENTS (10)

#else

#define FC4_W_FRAQ   (FRQ_BITS(FC4_W_INT, w_type))
#define L4_WQ(val)   QMN(w_type, FC4_W_FRAQ, val)

#endif

#define FC4_B_SHAPE {10}
#define FC4_B_MEM_STRIDE {1}
#define FC4_B_ELEMENTS (10)
#define FC4_B_RANK (1)

#if (MODEL_BIT_DEPTH == MODEL_SA_8)

#define CONV4_B_FRAQ    conv4_b_fraq_arr
#define CONV4_B_SCALE   conv4_b_scale_arr
#define CONV4_B_ZP      conv4_b_zp_arr
#define CONV4_B_DIM     0
#define CONV4_B_SA_ELEMENTS (10)

#else

#define FC4_B_FRAQ   (FRQ_BITS(FC4_B_INT, w_type))
#define L4_BQ(val)   QMN(w_type, FC4_B_FRAQ, val)
#define FC4_OUT_FRAQ (FRQ_BITS(FC4_OUT_INT, d_type))

#endif

#define FC4_OUT_SIZE (10)
#endif  //_CIFAR10_CONSTANTS_H_
```

## src/cifar10_model.h
```c
/*
 * Copyright (c) 2021 Synopsys.
 *
 * SPDX-License-Identifier: Apache-2.0
 */

/*
 * Convolutional Neural network model for small pictures classification.
 * Based on standard Caffe [1] example for CIFAR-10 [2] dataset
 *
 * Correspondence of classes:
 *  0: airplane
 *  1: automobile
 *  2: bird
 *  3: cat
 *  4: deer
 *  5: dog
 *  6: frog
 *  7: horse
 *  8: ship
 *  9: truck
 *
 *  [1] https:github.com/BVLC/caffe/tree/master/examples/cifar10
 *  [2] https:www.cs.toronto.edu/~kriz/cifar.html
 */

#ifndef _CIFAR10_MODEL_H_
#define _CIFAR10_MODEL_H_

#include <stdint.h>

#include "mli_types.h"

/* -------------------------------------------------------------------------- */
/*                               Model interface                              */
/* -------------------------------------------------------------------------- */

/* Input tensor. */
/* To be filled with input image by user before calling inference function (cifar10_cf_net). */
#define IN_POINTS (32 * 32 * 3)
extern mli_tensor *const cifar10_cf_net_input;

/* Output tensor for model. Will be filled with probabilities vector by model */
#define OUT_POINTS (10)
extern mli_tensor *const cifar10_cf_net_output;

/*
 * Model inference function
 *
 * Get input data from cifar10_cf_net_input tensor (FX format), fed it to the neural network,
 * and writes results to cifar10_cf_net_output tensor (FX format). It is user responsibility
 * to prepare input tensor correctly before calling this function and get result from output tensor
 * after function finish
 *
 * params:
 * debug_ir_root -  Path to intermediate vectors prepared in IDX format (hardcoded names).
 *                  Provides opportunity to analyse intermediate results in terms of
 *                  similarity with reference data.
 *                  If path is incorrect it outputts only profiling data
 *                  If NULL is passed, no messages will be printed in inference
 */

void cifar10_cf_net(const char *debug_ir_root);

/* -------------------------------------------------------------------------- */
/*                        Model bit depth configuration                       */
/* -------------------------------------------------------------------------- */

#define MODEL_FX_8 (8)
#define MODEL_FX_16 (16)
#define MODEL_FX_8W16D (816)

#if !defined(MODEL_BIT_DEPTH)
#define MODEL_BIT_DEPTH (MODEL_FX_16)
#endif

#if !defined(MODEL_BIT_DEPTH) ||                                                                   \
	(MODEL_BIT_DEPTH != MODEL_FX_8 && MODEL_BIT_DEPTH != MODEL_FX_16 &&                        \
	 MODEL_BIT_DEPTH != MODEL_FX_8W16D)
#error "MODEL_BIT_DEPTH must be defined correctly!"
#endif

#if (MODEL_BIT_DEPTH == MODEL_FX_8)
typedef int8_t d_type;
#else
typedef int16_t d_type;
#endif

#endif /*_CIFAR10_MODEL_H_*/
```

## src/cifar10_model_chw.c
```c
/*
 * Copyright (c) 2021 Synopsys.
 *
 * SPDX-License-Identifier: Apache-2.0
 */

#include "cifar10_model.h"

#include <stdint.h>
#include <stdio.h>
#include <string.h>
#include <assert.h>

#include "mli_api.h"
#include "mli_types.h"
#include "mli_config.h"

#include "cifar10_constants.h"
#include "tests_aux.h"

#if (MODEL_BIT_DEPTH == MODEL_FX_8)
#define D_EL_TYPE (MLI_EL_FX_8)
#else
#define D_EL_TYPE (MLI_EL_FX_16)
#endif

/* -------------------------------------------------------------------------- */
/*                         Data related to the Module                         */
/* -------------------------------------------------------------------------- */

/* Intermediate data buffers (enough size for max intermediate results) */
#define IR_BUF_SZ_MOST (32 * 32 * 32) /*32768*/
#define IR_BUF_SZ_NEXT (32 * 16 * 16)
static d_type _Z x_mem_buf[IR_BUF_SZ_MOST];
static d_type _Y y_mem_buf[IR_BUF_SZ_NEXT];

/* Module Input/Output tensors and their's external interface */
static mli_tensor input = {
	.data = (void *)x_mem_buf,
	.capacity = sizeof(d_type) * IN_POINTS,
	.shape = { 32, 32, 3 },
	.rank = 3,
	.el_type = D_EL_TYPE,
	.el_params.fx.frac_bits = 7,
};

static mli_tensor output = {
	.data = (void *)y_mem_buf,
	.capacity = sizeof(d_type) * OUT_POINTS,
	.shape = { 10 },
	.rank = 1,
	.el_type = D_EL_TYPE,
	.el_params.fx.frac_bits = 0,
};

/* Interface variables: Available to user via main model header */
mli_tensor *const cifar10_cf_net_input = &input;
mli_tensor *const cifar10_cf_net_output = &output;

/* -----------------  Model description and configuration ---------------- */
/* Configuration objects for layers */

static const mli_permute_cfg permute_hwc2chw_cfg = { .perm_dim = { 2, 0, 1 } };

static const mli_conv2d_cfg shared_conv_cfg = { .stride_height = 1,
						.stride_width = 1,
						.padding_bottom = 2,
						.padding_top = 2,
						.padding_left = 2,
						.padding_right = 2,
						.relu.type = MLI_RELU_GEN };

static const mli_pool_cfg shared_pool_cfg = { .kernel_height = 3,
					      .kernel_width = 3,
					      .stride_height = 2,
					      .stride_width = 2,
					      .padding_bottom = 1,
					      .padding_top = 0,
					      .padding_left = 0,
					      .padding_right = 1 };

/* Conv 1 Layer related tensors */
static const mli_tensor L1_conv_wt = {
	.data = (void *)L1_conv_wt_buf,
	.capacity = CONV1_W_ELEMENTS * sizeof(w_type),
	.shape = CONV1_W_SHAPE,
	.rank = CONV1_W_RANK,
	.el_type = W_EL_TYPE,
	.el_params.fx.frac_bits = CONV1_W_FRAQ,
};

static const mli_tensor L1_conv_bias = {
	.data = (void *)L1_conv_bias_buf,
	.capacity = CONV1_B_ELEMENTS * sizeof(w_type),
	.shape = CONV1_B_SHAPE,
	.rank = CONV1_B_RANK,
	.el_type = W_EL_TYPE,
	.el_params.fx.frac_bits = CONV1_B_FRAQ,
};

/* Conv 2 Layer related data */
static mli_tensor L2_conv_wt = {
	.data = (void *)L2_conv_wt_buf,
	.capacity = CONV2_W_ELEMENTS * sizeof(w_type),
	.shape = CONV2_W_SHAPE,
	.rank = CONV2_W_RANK,
	.el_type = W_EL_TYPE,
	.el_params.fx.frac_bits = CONV2_W_FRAQ,
};

static mli_tensor L2_conv_bias = {
	.data = (void *)L2_conv_bias_buf,
	.capacity = CONV2_B_ELEMENTS * sizeof(w_type),
	.shape = CONV2_B_SHAPE,
	.rank = CONV2_B_RANK,
	.el_type = W_EL_TYPE,
	.el_params.fx.frac_bits = CONV2_B_FRAQ,
};

/* Conv 3 Layer related data */
static mli_tensor L3_conv_wt = {
	.data = (void *)L3_conv_wt_buf,
	.capacity = CONV3_W_ELEMENTS * sizeof(w_type),
	.shape = CONV3_W_SHAPE,
	.rank = CONV3_W_RANK,
	.el_type = W_EL_TYPE,
	.el_params.fx.frac_bits = CONV3_W_FRAQ,
};

static mli_tensor L3_conv_bias = {
	.data = (void *)L3_conv_bias_buf,
	.capacity = CONV3_B_ELEMENTS * sizeof(w_type),
	.shape = CONV3_B_SHAPE,
	.rank = CONV3_B_RANK,
	.el_type = W_EL_TYPE,
	.el_params.fx.frac_bits = CONV3_B_FRAQ,
};

/* FC4 Layer related data */
static mli_tensor L4_fc_wt = {
	.data = (void *)L4_fc_wt_buf,
	.capacity = FC4_W_ELEMENTS * sizeof(w_type),
	.shape = FC4_W_SHAPE,
	.rank = FC4_W_RANK,
	.el_type = W_EL_TYPE,
	.el_params.fx.frac_bits = FC4_W_FRAQ,
};

static mli_tensor L4_fc_bias = {
	.data = (void *)L4_fc_bias_buf,
	.capacity = FC4_B_ELEMENTS * sizeof(w_type),
	.shape = FC4_B_SHAPE,
	.rank = FC4_B_RANK,
	.el_type = W_EL_TYPE,
	.el_params.fx.frac_bits = FC4_B_FRAQ,
};

#if defined(MODEL_BIG)
/* FC5 Layer related data */
static mli_tensor L5_fc_wt = {
	.data = (void *)L5_fc_wt_buf,
	.capacity = FC5_W_ELEMENTS * sizeof(w_type),
	.shape = FC5_W_SHAPE,
	.rank = FC5_W_RANK,
	.el_type = W_EL_TYPE,
	.el_params.fx.frac_bits = FC5_W_FRAQ,
};

static mli_tensor L5_fc_bias = {
	.data = (void *)L5_fc_bias_buf,
	.capacity = FC5_B_ELEMENTS * sizeof(w_type),
	.shape = FC5_B_SHAPE,
	.rank = FC5_B_RANK,
	.el_type = W_EL_TYPE,
	.el_params.fx.frac_bits = FC5_B_FRAQ,
};
#endif /*#if defined(MODEL_BIG)*/

/* Intermediate result tensors */
static mli_tensor ir_tensor_X = {
	.data = (void *)x_mem_buf,
	.capacity = sizeof(x_mem_buf),
	.shape = { 0, 0, 0, 0 },
	.rank = 4,
	.el_type = D_EL_TYPE,
	.el_params.fx.frac_bits = FRQ_BITS(0, d_type),
};

static mli_tensor ir_tensor_Y = {
	.data = (void *)y_mem_buf,
	.capacity = sizeof(y_mem_buf),
	.shape = { 0, 0, 0, 0 },
	.rank = 4,
	.el_type = D_EL_TYPE,
	.el_params.fx.frac_bits = FRQ_BITS(0, d_type),
};

/*  Wrappers on MLI calls to deal with various */
/*  bit depth configurable in compile time */

static inline mli_status maxpool_chw(const mli_tensor *in, const mli_pool_cfg *cfg,
				     mli_tensor *out);

static inline mli_status avepool_chw(const mli_tensor *in, const mli_pool_cfg *cfg,
				     mli_tensor *out);

static inline mli_status softmax(const mli_tensor *in, mli_tensor *out);

static inline mli_status relu(const mli_tensor *in, const mli_relu_cfg *cfg, mli_tensor *out);

static inline mli_status mli_krn_permute_fx(const mli_tensor *in, const mli_permute_cfg *cfg,
					    mli_tensor *out);

static inline mli_status conv2d_chw(const mli_tensor *in, const mli_tensor *weights,
				    const mli_tensor *bias, const mli_conv2d_cfg *cfg,
				    mli_tensor *out);

static inline mli_status fully_connected(const mli_tensor *in, const mli_tensor *weights,
					 const mli_tensor *bias, mli_tensor *out);

/* ------------------- Check kernel result. Debug function ------------------ */

static void check_result(const char *ir_root, const char *ref_file, mli_tensor *pred_tsr,
			 unsigned int cycles, mli_status ret_code);

/* ------------------ CIFAR10 graph based on Caffe example. ----------------- */
/* ----------------- Layer-by-Layer execution for CHW layput ---------------- */

void cifar10_cf_net(const char *debug_ir_root)
{
	if (debug_ir_root == NULL) {
/* Version A: Pure implementation: without return status checking and profiling wrappers */
		/* LAYER 0: Change RGB Image layout */
		mli_krn_permute_fx(&input, &permute_hwc2chw_cfg, &ir_tensor_Y);

		/* --------------------------------- LAYER 1 -------------------------------- */
		ir_tensor_X.el_params.fx.frac_bits = CONV1_OUT_FRAQ;
		conv2d_chw(&ir_tensor_Y, &L1_conv_wt, &L1_conv_bias, &shared_conv_cfg,
			   &ir_tensor_X);
		maxpool_chw(&ir_tensor_X, &shared_pool_cfg, &ir_tensor_Y);

		/* --------------------------------- LAYER 2 -------------------------------- */
		ir_tensor_X.el_params.fx.frac_bits = CONV2_OUT_FRAQ;
		conv2d_chw(&ir_tensor_Y, &L2_conv_wt, &L2_conv_bias, &shared_conv_cfg,
			   &ir_tensor_X);
		avepool_chw(&ir_tensor_X, &shared_pool_cfg, &ir_tensor_Y);

		/* --------------------------------- LAYER 3 -------------------------------- */
		ir_tensor_X.el_params.fx.frac_bits = CONV3_OUT_FRAQ;
		conv2d_chw(&ir_tensor_Y, &L3_conv_wt, &L3_conv_bias, &shared_conv_cfg,
			   &ir_tensor_X);
		avepool_chw(&ir_tensor_X, &shared_pool_cfg, &ir_tensor_Y);

		/* --------------------------------- LAYER 4 -------------------------------- */
		ir_tensor_X.el_params.fx.frac_bits = FC4_OUT_FRAQ;
		fully_connected(&ir_tensor_Y, &L4_fc_wt, &L4_fc_bias, &ir_tensor_X);

#if defined(MODEL_BIG)
		/* --------------------------------- LAYER 5 -------------------------------- */
		ir_tensor_Y.el_params.fx.frac_bits = FC5_OUT_FRAQ;
		fully_connected(&ir_tensor_X, &L5_fc_wt, &L5_fc_bias, &ir_tensor_Y);
		softmax(&ir_tensor_Y, &output);
#else
		softmax(&ir_tensor_X, &output);
#endif

	} else {
	/* Version B: Wrapped by service code for profiling and IR results checking purpose */
		mli_status ret = MLI_STATUS_OK;
		unsigned int layer1_cycles = 0;
		unsigned int layer2_cycles = 0;
		unsigned int layer3_cycles = 0;
		unsigned int layer4_cycles = 0;
		unsigned int layer5_cycles = 0;

		/* ------------------------- Change RGB Image layout ------------------------ */
		PROFILE(ret = mli_krn_permute_fx(&input, &permute_hwc2chw_cfg, &ir_tensor_Y));
		check_result(debug_ir_root, "RGB_2_CHW", &ir_tensor_Y, cycle_cnt, ret);
		layer1_cycles += cycle_cnt;

		/* --------------------------------- LAYER 1 -------------------------------- */
		ir_tensor_X.el_params.fx.frac_bits = CONV1_OUT_FRAQ;
		PROFILE(ret = conv2d_chw(&ir_tensor_Y, &L1_conv_wt, &L1_conv_bias, &shared_conv_cfg,
					 &ir_tensor_X));
		check_result(debug_ir_root, "ir_conv1.idx", &ir_tensor_X, cycle_cnt, ret);
		layer1_cycles += cycle_cnt;

		PROFILE(ret = maxpool_chw(&ir_tensor_X, &shared_pool_cfg, &ir_tensor_Y));
		check_result(debug_ir_root, "ir_pool1.idx", &ir_tensor_Y, cycle_cnt, ret);
		layer1_cycles += cycle_cnt;

		/* --------------------------------- LAYER 2 -------------------------------- */
		ir_tensor_X.el_params.fx.frac_bits = CONV2_OUT_FRAQ;
		PROFILE(ret = conv2d_chw(&ir_tensor_Y, &L2_conv_wt, &L2_conv_bias, &shared_conv_cfg,
					 &ir_tensor_X));
		check_result(debug_ir_root, "ir_conv2.idx", &ir_tensor_X, cycle_cnt, ret);
		layer2_cycles += cycle_cnt;

		PROFILE(ret = avepool_chw(&ir_tensor_X, &shared_pool_cfg, &ir_tensor_Y));
		check_result(debug_ir_root, "ir_pool2.idx", &ir_tensor_Y, cycle_cnt, ret);
		layer2_cycles += cycle_cnt;

		/* --------------------------------- LAYER 3 -------------------------------- */
		ir_tensor_X.el_params.fx.frac_bits = CONV3_OUT_FRAQ;
		PROFILE(ret = conv2d_chw(&ir_tensor_Y, &L3_conv_wt, &L3_conv_bias, &shared_conv_cfg,
					 &ir_tensor_X));
		check_result(debug_ir_root, "ir_conv3.idx", &ir_tensor_X, cycle_cnt, ret);
		layer3_cycles += cycle_cnt;

		PROFILE(ret = avepool_chw(&ir_tensor_X, &shared_pool_cfg, &ir_tensor_Y));
		check_result(debug_ir_root, "ir_pool3.idx", &ir_tensor_Y, cycle_cnt, ret);
		layer3_cycles += cycle_cnt;

		/* --------------------------------- LAYER 4 -------------------------------- */
		ir_tensor_X.el_params.fx.frac_bits = FC4_OUT_FRAQ;
		PROFILE(ret = fully_connected(&ir_tensor_Y, &L4_fc_wt, &L4_fc_bias, &ir_tensor_X));
		check_result(debug_ir_root, "ir_ip1.idx", &ir_tensor_X, cycle_cnt, ret);
		layer4_cycles += cycle_cnt;

		/* --------------------------------- LAYER 5 -------------------------------- */
#if defined(MODEL_BIG)
		ir_tensor_Y.el_params.fx.frac_bits = FC5_OUT_FRAQ;
		PROFILE(ret = fully_connected(&ir_tensor_X, &L5_fc_wt, &L5_fc_bias, &ir_tensor_Y));
		check_result(debug_ir_root, "ir_ip2.idx", &ir_tensor_Y, cycle_cnt, ret);
		layer5_cycles += cycle_cnt;

		PROFILE(ret = softmax(&ir_tensor_Y, &output));
		check_result(debug_ir_root, "ir_prob.idx", &output, cycle_cnt, ret);
		layer5_cycles += cycle_cnt;
#else
		PROFILE(ret = softmax(&ir_tensor_X, &output));
		check_result(debug_ir_root, "ir_prob.idx", &output, cycle_cnt, ret);
		layer5_cycles += cycle_cnt;
#endif

		const unsigned int total = layer1_cycles + layer2_cycles + layer3_cycles +
					   layer4_cycles + layer5_cycles;
		printf("\n\nSummary:\n"
		       "\tLayer1: %u cycles\n"
		       "\tLayer2: %u cycles\n"
		       "\tLayer3: %u cycles\n"
		       "\tLayer4: %u cycles\n"
		       "\tLayer5: %u cycles\n"
		       "\n\tTotal: %u cycles\n\n",
		       layer1_cycles, layer2_cycles, layer3_cycles, layer4_cycles, layer5_cycles,
		       total);
	}
}

/* ----------------- Checking kernel result. Debug function ----------------- */

static void check_result(const char *ir_root, const char *ref_file, mli_tensor *pred_tsr,
			 unsigned int cycles, mli_status ret_code)
{
	if (ret_code != MLI_STATUS_OK) {
		printf("ERROR: MLI Code for %s (%d) is not OK\n", ref_file, ret_code);
		assert(0);
	}

	if (ir_root != NULL) {
		ref_to_pred_output err;
		test_status test_result = measure_ref_to_pred(ir_root, ref_file, *pred_tsr, &err);

		if (test_result == TEST_PASSED) {
			printf("%s:\n\tS/N=%-10.1f (%-4.1f db)\n\t%u cycles\n", ref_file,
			       err.ref_vec_length / err.noise_vec_length, err.ref_to_noise_snr,
			       cycles);
		} else if (test_result == TEST_FAILED) {
			printf("ERROR: Test suit returns FAILED code for %s\n", ref_file);
			assert(0);
		} else {
			printf("%s(w/o IR check):\t%u cycles\n", ref_file, cycles);
		}
	}
}

/* -------------------------------------------------------------------------- */
/*                 MLI Functions wrappers: Kernels w/o weights                */
/* -------------------------------------------------------------------------- */
#if (MODEL_BIT_DEPTH != MODEL_FX_8)
static inline mli_status maxpool_chw(const mli_tensor *in, const mli_pool_cfg *cfg, mli_tensor *out)
{
	return mli_krn_maxpool_chw_fx16_k3x3_krnpad(in, cfg, out);
}

static inline mli_status avepool_chw(const mli_tensor *in, const mli_pool_cfg *cfg, mli_tensor *out)
{
	return mli_krn_avepool_chw_fx16_k3x3_krnpad(in, cfg, out);
}

static inline mli_status softmax(const mli_tensor *in, mli_tensor *out)
{
	return mli_krn_softmax_fx16(in, out);
}

static inline mli_status relu(const mli_tensor *in, const mli_relu_cfg *cfg, mli_tensor *out)
{
	return mli_krn_relu_fx16(in, cfg, out);
}

static inline mli_status mli_krn_permute_fx(const mli_tensor *in, const mli_permute_cfg *cfg,
					    mli_tensor *out)
{
	return mli_krn_permute_fx16(in, cfg, out);
}

#else /* MODEL_BIT_DEPTH == (MODEL_FX_8W16D || MODEL_FX_8W16D) */
static inline mli_status maxpool_chw(const mli_tensor *in, const mli_pool_cfg *cfg, mli_tensor *out)
{
	return mli_krn_maxpool_chw_fx8_k3x3_krnpad(in, cfg, out);
}

static inline mli_status avepool_chw(const mli_tensor *in, const mli_pool_cfg *cfg, mli_tensor *out)
{
	return mli_krn_avepool_chw_fx8_k3x3_krnpad(in, cfg, out);
}

static inline mli_status softmax(const mli_tensor *in, mli_tensor *out)
{
	return mli_krn_softmax_fx8(in, out);
}

static inline mli_status relu(const mli_tensor *in, const mli_relu_cfg *cfg, mli_tensor *out)
{
	return mli_krn_relu_fx8(in, cfg, out);
}

static inline mli_status mli_krn_permute_fx(const mli_tensor *in, const mli_permute_cfg *cfg,
					    mli_tensor *out)
{
	return mli_krn_permute_fx8(in, cfg, out);
}

#endif

/* -------------------------------------------------------------------------- */
/*                MLI Functions wrappers: Kernels with weights                */
/* -------------------------------------------------------------------------- */

#if (MODEL_BIT_DEPTH == MODEL_FX_8)
static inline mli_status conv2d_chw(const mli_tensor *in, const mli_tensor *weights,
				    const mli_tensor *bias, const mli_conv2d_cfg *cfg,
				    mli_tensor *out)
{
	return mli_krn_conv2d_chw_fx8_k5x5_str1_krnpad(in, weights, bias, cfg, out);
}

static inline mli_status fully_connected(const mli_tensor *in, const mli_tensor *weights,
					 const mli_tensor *bias, mli_tensor *out)
{
	return mli_krn_fully_connected_fx8(in, weights, bias, out);
}

#elif (MODEL_BIT_DEPTH == MODEL_FX_16)
static inline mli_status conv2d_chw(const mli_tensor *in, const mli_tensor *weights,
				    const mli_tensor *bias, const mli_conv2d_cfg *cfg,
				    mli_tensor *out)
{
	return mli_krn_conv2d_chw_fx16_k5x5_str1_krnpad(in, weights, bias, cfg, out);
}

static inline mli_status fully_connected(const mli_tensor *in, const mli_tensor *weights,
					 const mli_tensor *bias, mli_tensor *out)
{
	return mli_krn_fully_connected_fx16(in, weights, bias, out);
}

#else /* MODEL_BIT_DEPTH == MODEL_FX_8W16D */
static inline mli_status conv2d_chw(const mli_tensor *in, const mli_tensor *weights,
				    const mli_tensor *bias, const mli_conv2d_cfg *cfg,
				    mli_tensor *out)
{
	return mli_krn_conv2d_chw_fx8w16d(in, weights, bias, cfg, out);
}

static inline mli_status fully_connected(const mli_tensor *in, const mli_tensor *weights,
					 const mli_tensor *bias, mli_tensor *out)
{
	return mli_krn_fully_connected_fx8w16d(in, weights, bias, out);
}
#endif
```

## src/ml_api_cifar10_caffe_main.c
```c
/*
 * Copyright (c) 2021 Synopsys
 *
 * SPDX-License-Identifier: Apache-2.0
 */

#include <stdint.h>
#include <stdio.h>
#include <stdlib.h>
#include <string.h>
#include <assert.h>
#include <zephyr.h>
#include "mli_types.h"

#include "cifar10_ref_inout.h"
#include "cifar10_model.h"
#include "examples_aux.h"
#include "tests_aux.h"

#if defined (_ARC) && defined (__GNUC__) && !defined (__CCAC__)
#define ARC_GNU
#endif

#if defined (ARC_GNU)
extern int start_init(void);
#endif 

// Root to referenc IR vectors for comparison
// pass "./ir_idx_12_hwcn_small" for debug
static const char kCifar10RootIR[] = "";
static const char kOutFilePostfix[] = "_out";

const unsigned char kSingleIn[IN_POINTS] = IN_IMG_12;
const float kSingleOutRef[OUT_POINTS] = OUT_PROB_12;

static void cifar10_preprocessing(const void * image_, mli_tensor * net_input_);

#define EXAMPLE_MAX_MODE (3)
int mode=0; // emulation argc for GNU toolchain
char param[EXAMPLE_MAX_MODE][256];// emulation argv for GNU toolchain
//========================================================================================
//
// MAIN
//
//========================================================================================
int main(int argc, char ** argv ) {
#if defined (ARC_GNU)
//ARC GNU tools
    if (0 != start_init() ){
        printf("ERROR: init proccesor\n");
        //Error init proccesor;
        return 1;
    }
//fill mode and param from cmd line script before use

#else
//Metaware tools
//fill mode and param from argc and argv
    if ( argc <= EXAMPLE_MAX_MODE) {
        mode=argc;
    
        for(int i=0; i < mode; i++) {
            memcpy( &param[i][0], argv[i], strlen(argv[i]) );
        }
    }    
#endif // if defined (ARC_GNU)

   	mode = 3;
	strcpy(param[0], "dummy_for_check");
	strcpy(param[1], "small_test_base/tests.idx");
	strcpy(param[2], "small_test_base/labels.idx");
    //checking that variables are set
    if(mode == 0){
        printf("ERROR: mode not set up\n");
#if defined (ARC_GNU)
//ARC GNU tools
        printf("Please set up mode \n");
        printf("Please check that you use mdb_com_gnu script with correct setups\n");
#else
//Metaware tools    
        printf("App command line:\n"
                "\t%s \n\t\tProcess single hardcoded vector\n\n"
                "\t%s <input_test_base.idx> \n\t\tProcess testset from file and \n"
                "\t\t output model results to <input_test_base.idx_out> file\n\n", argv[0], argv[0]);
#endif // if defined (ARC_GNU)
        return 2; //Error: mode not set       
    } 
    
    for(int i=0; i < mode; i++) {
       if (param[i][0] == 0){
           printf("param[%d][0] not set.\n", i);
           if (i==0) printf("Please set up dummy string for check.\n");
           if (i==1) printf("Please set up input IDX file.\n");
           if (i==2) printf("Please set up labels IDX file.\n");
           return 2; //Error: param not set
       }
    }

    mli_status status = cifar10_cf_init();
    if (status != MLI_STATUS_OK) {
    	printf("Failed to initialize lut for softmax\n");
    	return 2; // Error: lut couldn't be initialized
    }

    switch (mode) {
    // No Arguments for app. Process single hardcoded input
    // Print various measures to stdout
    //=========================================================
    case 1:
        printf("HARDCODED INPUT PROCESSING\n");
        model_run_single_in(kSingleIn, kSingleOutRef,
                cifar10_cf_net_input, cifar10_cf_net_output,
                cifar10_preprocessing, cifar10_cf_net,
                kCifar10RootIR);
        break;

    // APP <input_test_base.idx>
    // Output vectors will be written to <input_test_base.idx_out> file
    //=================================================================
    case 2:
        printf("Input IDX testset to output IDX set\n");
        char * out_path = malloc(strlen(param[1]) + strlen(kOutFilePostfix) + 1);
        if (out_path == NULL) {
            printf("mem allocation failed\n");
            break;
        }
        out_path[0] = 0;
        strcat(out_path, param[1]);
        strcat(out_path, kOutFilePostfix);

        model_run_idx_base_to_idx_out(param[1], out_path,
                cifar10_cf_net_input, cifar10_cf_net_output,
                cifar10_preprocessing, cifar10_cf_net,
                NULL);
        free(out_path);
        break;

    // APP <input_test_base.idx> <input_test_labels.idx>
    // Calculate accuracy of the model
    //=================================================================
    case 3:
        printf("ACCURACY CALCULATION on Input IDX testset according to IDX labels set\n");
        model_run_acc_on_idx_base(param[1], param[2],
                cifar10_cf_net_input, cifar10_cf_net_output,
                cifar10_preprocessing, cifar10_cf_net,
                NULL);
        break;

    // Unknown format
    //=================================================================
    default:
        printf("App command line:\n"
                "\t%s \n\t\tProcess single hardcoded vector\n\n"
                "\t%s <input_test_base.idx> \n\t\tProcess testset from file and \n"
                "\t\t output model results to <input_test_base.idx_out> file\n\n", argv[0], argv[0]);
        break;
    }
    printf("FINISHED\n");

    return 0;
}

//========================================================================================
//
// Other internal functions and routines
//
//========================================================================================

//========================================================================================
// Image pre-processing for CIFAR-10 net
//========================================================================================
static void cifar10_preprocessing(const void * image_, mli_tensor * net_input_) {
    const unsigned char * in = image_;
    d_type * const dst = (d_type * const)net_input_->data.mem.D_FIELD;

    // Copying data  to input tensor with subtraction of average.
    // Data shft may be required depending on tensor format
    if (net_input_->el_params.fx.frac_bits == 7 || net_input_->el_type == MLI_EL_SA_8) {
        for (int idx = 0; idx < IN_POINTS; idx++)
            dst[idx] = (d_type)((int)in[idx] - 128);
    } else if (net_input_->el_params.fx.frac_bits > 7) {
        int shift_left = net_input_->el_params.fx.frac_bits - 7;
        for (int idx = 0; idx < IN_POINTS; idx++)
            dst[idx] = (d_type)((int)in[idx] - 128) << shift_left;
    } else {
        int shift_right = 7 - net_input_->el_params.fx.frac_bits;
        for (int idx = 0; idx < IN_POINTS; idx++)
            dst[idx] = (d_type)((int)in[idx] - 128)  >> shift_right; // w/o rounding
    }
}
```
