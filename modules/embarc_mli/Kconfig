## modules/embarc_mli/Kconfig
```kconfig
# Copyright (c) 2021 Synopsys
# SPDX-License-Identifier: Apache-2.0

config ZEPHYR_EMBARC_MLI_MODULE
	bool

config EMBARC_MLI
	bool "embarc_mli Support"
	help
	  This option enables the embarc_mli library.

config EMBARC_MLI_DSP_XY
	bool "for targets with XY mem and DSP"
	help
	  Set if embarc mli library is for targets with XY mem and DSP,
	  e.g., EM9D, EM11D.

config EMBARC_MLI_DSP_WIDE
	bool "for targets with wide DSP"
	help
	  Set if embarc mli library is for targets with wide DSP,
	  e.g., HS45D, HS47D.

config EMBARC_MLI_DSP
	bool "for targets with DSP only"
	help
	  Set if embarc mli library is for targets with DSP only,
	  e.g., EM5D, EM7D

config EMBARC_MLI_HW_TCF_FILE
	string "Target tcf file to build embarc mli library"
	default "../../hw/em9d.tcf"
	help
	   The target tcf file to build embarc mli library. For details
	   please refere embarc mli's documentation
```

## subsys/dsp/Kconfig
```kconfig
# Copyright (c) 2022 Google LLC
# SPDX-License-Identifier: Apache-2.0

config DSP_BACKEND_HAS_STATIC
	bool

config DSP_BACKEND_CMSIS
	bool "Use the CMSIS-DSP library as the math backend"
	depends on CMSIS_DSP
	select DSP_BACKEND_HAS_STATIC
	help
	  Implement the various zephyr DSP functions using the CMSIS-DSP library. This feature
	  requires the CMSIS module to be selected.

config DSP_BACKEND_MWDT_DSPLIB
	bool "Use the mwdt library as the math backend"
	depends on CMSIS_DSP
	select DSP_BACKEND_HAS_STATIC
	help
	  Implement the various zephyr DSP functions using the MWDT-DSP library.
```
